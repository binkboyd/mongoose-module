## Kconfig
```kconfig
menu "mongoose library support"

config MONGOOSE
	bool "mongoose web library"

if MONGOOSE

config MONGOOSE_VERBOSE
	bool "Make zcbor code print messages"

config MONGOOSE_ENABLE_PACKED_FS
	bool "enabled packed filesystem"
	default y

endif #MONGOOSE

endmenu
```
